
qcom,2348488_tcl_tlp058b2_5830mah_averaged_masterslave_mar10th2016 {
	/* #2348488_TCL_TLp058B2_5830mAh_averaged_MasterSlave_Mar10th2016*/
	qcom,max-voltage-uv = <4400000>;
	qcom,nom-batt-capacity-mah = <5830>;
	qcom,batt-id-kohm = <51>;
	qcom,battery-beta = <3435>;
	qcom,battery-type = "TLP058b2_5830mah";
	qcom,chg-rslow-comp-c1 = <2779313>;
	qcom,chg-rslow-comp-c2 = <3279115>;
	qcom,chg-rs-to-rslow = <861345>;
	qcom,chg-rslow-comp-thr = <0x99>;
	qcom,fg-cc-cv-threshold-mv = <4390>;
	qcom,checksum = <0x5EE6>;
	qcom,gui-version = "PMI8950GUI - 2.0.0.15";
	qcom,fg-profile-data = [
		 02 88 2B 7E 
		 26 82 B1 7C 
		 74 83 19 7C 
		 2E 8B 48 95 
		 3C 82 A0 98 
		 45 B6 AC C1 
		 5D 17 FE 83 
		 A4 7D CC 81 
		 68 7C 77 83 
		 40 77 C5 8B 
		 95 96 5B 82 
		 F0 98 BE B7 
		 0C C8 52 12 
		 7B 17 C0 58 
		 14 70 85 FB 
		 24 3C 2D 46 
		 36 3B 00 00 
		 35 46 6E 34 
		 FE 12 00 00 
		 00 00 00 00 
		 00 00 00 00 
		 1D 70 B2 69 
		 5B 63 3E 8A 
		 B5 7C 24 71 
		 5F 54 B1 82 
		 84 76 9A 69 
		 5D 75 9B 9B 
		 23 EF 5A C6 
		 5C A0 71 0C 
		 28 00 FF 36 
		 F0 11 30 03 
		 00 00 00 0C 
	];
};
