/* Copyright (c) 2015, The Linux Foundation. All rights reserved.
 *
 * This program is free software; you can redistribute it and/or modify
 * it under the terms of the GNU General Public License version 2 and
 * only version 2 as published by the Free Software Foundation.
 *
 * This program is distributed in the hope that it will be useful,
 * but WITHOUT ANY WARRANTY; without even the implied warranty of
 * MERCHANTABILITY or FITNESS FOR A PARTICULAR PURPOSE.  See the
 * GNU General Public License for more details.
 */

&mdss_mdp {
	dsi_nt51021b_1200p_video: qcom,mdss_dsi_nt51021b_1200p_video {
		qcom,mdss-dsi-panel-name = "nt51021b video mode dsi panel";
		qcom,mdss-dsi-panel-controller = <&mdss_dsi0>;
		qcom,mdss-dsi-panel-type = "dsi_video_mode";
		qcom,mdss-dsi-panel-destination = "display_1";
		qcom,mdss-dsi-panel-framerate = <60>;
		qcom,mdss-dsi-virtual-channel-id = <0>;
		qcom,mdss-dsi-stream = <0>;
		qcom,mdss-dsi-panel-width = <1200>;
		qcom,mdss-dsi-panel-height = <1920>;
		/*[BUGFIX]-Mod-BEGIN by SCDTABLET.jinghuang@tcl.com,03/14/2016,1806036,*/
		/*modify DPT lcd timming and init code*/
		qcom,mdss-dsi-h-front-porch = <44>;
		qcom,mdss-dsi-h-back-porch = <32>;
		/*[BUGFIX]-Mod-END by SCDTABLET.jinghuang@tcl.com*/
		qcom,mdss-dsi-h-pulse-width = <4>;
		qcom,mdss-dsi-h-sync-skew = <0>;
		/*[BUGFIX]-Mod-BEGIN by SCDTABLET.jinghuang@tcl.com,03/14/2016,1806036,*/
		/*modify DPT lcd timming and init code*/
		qcom,mdss-dsi-v-back-porch = <25>;
		qcom,mdss-dsi-v-front-porch = <35>;
		/*[BUGFIX]-Mod-END by SCDTABLET.jinghuang@tcl.com*/
		qcom,mdss-dsi-v-pulse-width = <1>;
		qcom,mdss-dsi-h-left-border = <0>;
		qcom,mdss-dsi-h-right-border = <0>;
		qcom,mdss-dsi-v-top-border = <0>;
		qcom,mdss-dsi-v-bottom-border = <0>;
		qcom,mdss-dsi-bpp = <24>;
		qcom,mdss-dsi-underflow-color = <0xff>;
		qcom,mdss-dsi-border-color = <0>;
		qcom,mdss-dsi-lp11-init;
		qcom,mdss-dsi-init-delay-us = <5>;
		/*[BUGFIX]-Mod-BEGIN by SCDTABLET.jinghuang@tcl.com,04/01/2016,1899100,*/
		/*disable sync signal and delect 11 29*/
		/*[BUGFIX]-Mod-BEGIN by SCDTABLET.jinghuang@tcl.com,03/14/2016,1806036,*/
		/*modify DPT lcd timming and init code*/
		qcom,mdss-dsi-on-command = [15 01 00 00 10 00 02 8F A5
			15 01 00 00 20 00 02 01 00
			15 01 00 00 10 00 02 8F A5
			15 01 00 00 10 00 02 83 AA
			15 01 00 00 10 00 02 84 11
			15 01 00 00 10 00 02 A9 4B
			15 01 00 00 10 00 02 83 00
			15 01 00 00 10 00 02 84 00
			15 01 00 00 10 00 02 8F 00
			/*05 01 00 00 a0 00 02 11 00*/
			/*05 01 00 00 f0 00 02 29 00*/];
		/*[BUGFIX]-Mod-END by SCDTABLET.jinghuang@tcl.com*/
		/*[BUGFIX]-Mod-END by SCDTABLET.jinghuang@tcl.com*/
		qcom,mdss-dsi-off-command = [05 01 00 00 78 00 02 28 00
				 05 01 00 00 78 00 02 10 00];
		qcom,mdss-dsi-on-command-state = "dsi_lp_mode";
		qcom,mdss-dsi-off-command-state = "dsi_lp_mode";
		qcom,mdss-dsi-h-sync-pulse = <1>;
		qcom,mdss-dsi-traffic-mode = "burst_mode";
		qcom,mdss-dsi-bllp-eof-power-mode;
		/*qcom,mdss-dsi-bllp-power-mode;*/
		qcom,mdss-dsi-lane-0-state;
		qcom,mdss-dsi-lane-1-state;
		qcom,mdss-dsi-lane-2-state;
		qcom,mdss-dsi-lane-3-state;
		/*[BUGFIX]-Mod-BEGIN by SCDTABLET.jinghuang@tcl.com,04/01/2016,1899100,*/
		/*disable sync signal and delect 11 29*/
		/*qcom,cmd-sync-wait-broadcast;*/
		/*[BUGFIX]-Mod-END by SCDTABLET.jinghuang@tcl.com*/
		/*[BUGFIX]-Mod-BEGIN by SCDTABLET.jinghuang@tcl.com,03/14/2016,1806036,*/
		/*modify DPT lcd timming and init code*/
		qcom,mdss-dsi-panel-timings = [eb 38 26 00 6a 6e 2c 3c 2f 03 04 00];
		qcom,mdss-dsi-t-clk-post = <0x02>;
		qcom,mdss-dsi-t-clk-pre = <0x2c>;
		/*[BUGFIX]-Mod-END by SCDTABLET.jinghuang@tcl.com*/
		qcom,mdss-dsi-dma-trigger = "trigger_sw";
		qcom,mdss-dsi-mdp-trigger = "none";
		qcom,mdss-dsi-bl-min-level = <8>;
		/*[BUGFIX]-Mod-BEGIN by SCDTABLET.jinghuang@tcl.com,01/27/2016,1532320,modify backlight control and the max level and the limit current.*/
		qcom,mdss-dsi-bl-max-level = <4095>;
		/*[BUGFIX]-Mod-END by SCDTABLET.jinghuang@tcl.com*/
		qcom,mdss-dsi-bl-pmic-control-type = "bl_ctrl_wled";
		qcom,mdss-dsi-reset-sequence = <1 20>, <0 20>, <1 50>;
	
	};
};
